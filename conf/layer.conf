## conf/layer.conf
```bitbake
# We have a conf directory, add to BBPATH
BBPATH =. "${LAYERDIR}:"

# We have recipes-* directories, add to BBFILES
BBFILES += "${LAYERDIR}/recipes-*/*/*.bb \
            ${LAYERDIR}/recipes-*/*/*.bbappend"

BBFILE_COLLECTIONS += "virtio_msg_demo"
BBFILE_PATTERN_virtio_msg_demo = "^${LAYERDIR}/"
BBFILE_PRIORITY_virtio_msg_demo = "9"

LAYERSERIES_COMPAT_virtio_msg_demo = "mickledore scarthgap nanbield"

# This should only be incremented on significant changes that will
# cause compatibility issues with other layers
LAYERVERSION_virtio_msg_demo = "2"

LAYERDEPENDS_virtio_msg_demo = "\
    core \
"
```
