//
// Xen overlay.
//
// Copyright (c) 2024 Advanced Micro Devices, Inc.
// Written by Edgar E. Iglesias <edgar.iglesias@amd.com>
//
// SPDX-License-Identifier: MIT
//
/ {
        chosen {
                #address-cells = <2>;
                #size-cells = <2>;

                xen,xen-bootargs = "console=dtuart dtuart=serial0 dom0_mem=5G dom0_max_vcpus=2 bootscrub=0 vwfi=native sched=null";

		// Boot from initrd.
//                xen,dom0-bootargs = "rdinit=init console=hvc0 earlycon=xenboot";
		// Boot from SD.
                xen,dom0-bootargs = "rootdelay=2 root=/dev/mmcblk0p2 console=hvc0 earlycon=xenboot clk_ignore_unused";

                module@0 {
                        compatible = "xen,linux-zimage", "multiboot,module";
			//reg = <0x0 0x47000000 0x0 0x29a1a00>;
			reg = <0x0 0xE00000 0x0 0x29a1a00>;
                };

		// Only needed when using initrd.
                module@1 {
                        compatible = "xen,linux-initrd", "xen,multiboot-module", "multiboot,module";
                        //reg = <0x0 0x50000000 0x0 0x20000000>;
			reg = <0x0 0x2600000 0x0 0x8030000>;
                };
        };
};
